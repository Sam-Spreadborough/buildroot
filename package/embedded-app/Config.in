## package/embedded-app/Config.in
```kconfig
config BR2_PACKAGE_EMBEDDED_APP
        bool "Embedded JUCE app"
        select BR2_PACKAGE_ALSA_LIB
        select BR2_PACKAGE_FREETYPE
        select BR2_PACKAGE_LIBCURL
        select BR2_PACKAGE_XLIB_LIBX11
	select BR2_PACKAGE_XLIB_LIBXCOMPOSITE
        select BR2_PACKAGE_XLIB_LIBXEXT
        select BR2_PACKAGE_XLIB_LIBXRANDR
	select BR2_PACKAGE_XLIB_LIBXRENDER
	select BR2_PACKAGE_XORG7
	select BR2_PACKAGE_LIBXCB
	select BR2_PACKAGE_XCB_PROTO
        depends on BR2_INSTALL_LIBSTDCPP
        depends on BR2_TOOLCHAIN_HAS_THREADS
        depends on BR2_TOOLCHAIN_USES_GLIBC
        help
          An example app based on JUCE 
```
